## components/audio_locator/Kconfig
```kconfig
menu "Audio Locator Configuration"

    config AUDIO_LOCATOR_ENABLE
        bool "Enable Audio Locator"
        default y
        help
            Enable sound source localization using dual I2S MEMS
            microphones (INMP441) with TDOA-based direction estimation.

    config AUDIO_LOCATOR_I2S_BCK
        int "I2S Bit Clock GPIO"
        range 0 48
        default 4
        help
            GPIO number for the I2S bit clock (shared by both mics).

    config AUDIO_LOCATOR_I2S_WS
        int "I2S Word Select GPIO"
        range 0 48
        default 5
        help
            GPIO number for the I2S word select / LR clock.

    config AUDIO_LOCATOR_I2S_DIN_LEFT
        int "Left Mic I2S Data GPIO"
        range 0 48
        default 6
        help
            GPIO number for the left-channel INMP441 I2S data input.

    config AUDIO_LOCATOR_I2S_DIN_RIGHT
        int "Right Mic I2S Data GPIO"
        range 0 48
        default 7
        help
            GPIO number for the right-channel INMP441 I2S data input.

    config AUDIO_LOCATOR_SAMPLE_RATE
        int "Audio Sample Rate (Hz)"
        default 16000
        range 8000 48000
        help
            Sample rate for I2S microphone input. 16kHz is sufficient
            for sound localization.

endmenu
```

## components/display_driver/Kconfig
```kconfig
menu "Display Driver Configuration"

    config DISPLAY_DRIVER_ENABLE
        bool "Enable Display Driver"
        default y
        help
            Enable ST7789 SPI display driver for the robot face screen.

    config DISPLAY_SPI_MOSI
        int "SPI MOSI GPIO"
        range 0 48
        default 13
        help
            GPIO number for the SPI MOSI data line to the ST7789 display.

    config DISPLAY_SPI_SCLK
        int "SPI SCLK GPIO"
        range 0 48
        default 14
        help
            GPIO number for the SPI clock line to the ST7789 display.

    config DISPLAY_CS_GPIO
        int "CS GPIO"
        range 0 48
        default 15
        help
            GPIO number for the chip select line to the ST7789 display.

    config DISPLAY_DC_GPIO
        int "DC GPIO"
        range 0 48
        default 16
        help
            GPIO number for the data/command line to the ST7789 display.

    config DISPLAY_RST_GPIO
        int "RST GPIO"
        range 0 48
        default 17
        help
            GPIO number for the reset line to the ST7789 display.

    config DISPLAY_BL_GPIO
        int "Backlight GPIO"
        range 0 48
        default 18
        help
            GPIO number for the backlight control of the ST7789 display.
            Set to -1 if backlight is hardwired.

endmenu
```

## components/logger_wrapper/Kconfig
```kconfig
menu "Logger Wrapper Configuration"

    config LOGGER_WRAPPER_ENABLE
        bool "Enable Logger Wrapper"
        default y
        help
            Enable the logger wrapper component. When enabled, all ESP_LOGx
            macros are intercepted and log entries are stored in a PSRAM
            ring buffer in addition to normal console output.

    config LOGGER_WRAPPER_RING_BUFFER_SIZE
        int "Ring buffer size (bytes)"
        default 32768
        range 1024 1048576
        depends on LOGGER_WRAPPER_ENABLE
        help
            Total size of the PSRAM ring buffer in bytes. Each log entry
            uses a fixed-size slot (header + max tag + max message).

    config LOGGER_WRAPPER_MAX_TAG_LEN
        int "Maximum tag length"
        default 32
        range 8 128
        depends on LOGGER_WRAPPER_ENABLE
        help
            Maximum length of log tag strings stored in the ring buffer.
            Tags longer than this will be truncated.

    config LOGGER_WRAPPER_MAX_MSG_LEN
        int "Maximum message length"
        default 256
        range 64 1024
        depends on LOGGER_WRAPPER_ENABLE
        help
            Maximum length of formatted log message strings stored in the
            ring buffer. Messages longer than this will be truncated.

endmenu
```

## components/motor_controller/Kconfig
```kconfig
menu "Motor Controller Configuration"

    config MOTOR_CONTROLLER_ENABLE
        bool "Enable Motor Controller"
        default y
        help
            Enable stepper motor control via TMC2209 driver for
            pan-axis rotation of the robot sphere.

    config MOTOR_STEP_GPIO
        int "STEP GPIO"
        range 0 48
        default 10
        help
            GPIO number for the STEP signal to the TMC2209 driver.

    config MOTOR_DIR_GPIO
        int "DIR GPIO"
        range 0 48
        default 11
        help
            GPIO number for the DIR signal to the TMC2209 driver.

    config MOTOR_EN_GPIO
        int "EN GPIO"
        range 0 48
        default 12
        help
            GPIO number for the EN (enable) signal to the TMC2209 driver.
            Low = enabled, High = disabled (internal pullup keeps motor off).

    config MOTOR_STEPS_PER_REV
        int "Steps per Revolution"
        default 200
        help
            Full steps per revolution without microstepping.
            200 = 1.8 degree per step (standard NEMA stepper).

    config MOTOR_MICROSTEPS
        int "Microstepping"
        default 16
        help
            Microstepping multiplier. 16 = 1/16 step (common for TMC2209).

endmenu
```

## components/robot_core/Kconfig
```kconfig
menu "Robot Core Configuration"

    config ROBOT_CORE_ENABLE
        bool "Enable Robot Core"
        default y
        help
            Enable the robot core state machine that coordinates
            audio localization, motor control, and display.

endmenu
```

## components/uart_comm/Kconfig
```kconfig
menu "UART Communication Configuration"

    config UART_COMM_ENABLE
        bool "Enable UART Communication"
        default y
        help
            Enable periodic robot status transmission over UART.

    config UART_COMM_PORT_NUM
        int "UART Port Number"
        default 1
        range 0 2
        help
            UART port number. 0 = built-in USB-UART (logs share),
            1 = UART1 (recommended for independent status output).

    config UART_COMM_TX_GPIO
        int "TX GPIO"
        range 0 48
        default 8
        help
            GPIO number for UART TX (status data output).

    config UART_COMM_RX_GPIO
        int "RX GPIO"
        range 0 48
        default 9
        help
            GPIO number for UART RX (command input, optional).

    config UART_COMM_BAUD_RATE
        int "Baud Rate"
        default 115200
        range 9600 921600
        help
            UART baud rate for status communication.

    config UART_COMM_INTERVAL_MS
        int "Status Report Interval (ms)"
        default 1000
        range 100 60000
        help
            How often the robot sends its status over UART.

endmenu
```

## main/Kconfig.projbuild
```kconfig
menu "Robot Configuration"

    config ROBOT_NAME
        string "Robot Name"
        default "V1"
        help
            Name identifier for this robot instance.

    config ROBOT_POLL_INTERVAL_MS
        int "Sensor Poll Interval (ms)"
        default 50
        range 10 500
        help
            Interval at which the robot core polls audio and motor state.

endmenu
```
